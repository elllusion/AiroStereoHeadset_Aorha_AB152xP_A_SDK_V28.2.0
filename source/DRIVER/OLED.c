//////////////////////////////////////////////////////////
// Copyright@ 2009 Airoha.  All right reserved.
//////////////////////////////////////////////////////////
#include "reside_flash.inc"

#define _OLED_C_

#include "os.h"
#include "rc.h"
#include "bt_config_profile.h"

#ifdef OLED_ENABLE

#include "OLED.h"
#include "I2C.h"

#define OLED_DELAY_COUNT	30 /*32 --> 10ms*/

typedef struct
{
	U8 XDATA_PTR OledShowBDAddr;
	OST XDATA_PTR OledShowBDAddrTimerPtr;
} OLED_CTRL_INFO;

static OLED_CTRL_INFO XDATA gOLED_ctl;

///////////////////////////////////////////////////////////////
// Constant
///////////////////////////////////////////////////////////////

static U8 CODE OLED_Libery [97][16]=
{
	0x00,0x00,0x00,0x00,0x00,0x00,0x00,0x00,0x00,0x00,0x00,0x00,0x00,0x00,0x00,0x00,/*" ",0*/
	
	0xF8,0xF8,0x00,0x00,0x00,0x00,0x00,0x00,0x3F,0x3F,0x00,0x00,0x00,0x00,0x00,0x00,/*"!",1*/
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	0x80,0xF0,0xF8,0x98,0x98,0x98,0x18,0x18,0x07,0x3F,0x7F,0x67,0x67,0x67,0x60,0x60,/*"",96*/
};

static U8 CODE OLED_StartupPicture[512] = 
{
	  0x00,0x00,0x00,0x00,0x00,0x00,0x00,0x00,0x00,0x00,0x00,0x00,0x00,0x00,0x00,0x00,     
      0x00,0x00,0x00,0x00,0x80,0x60,0xE0,0x80,0x00,0x00,0x00,0x00,0x00,0x00,0x00,0x00,
      0x00,0x00,0x00,0x20,0x20,0x20,0xE0,0xE0,0x20,0x20,0x20,0x00,0x00,0x00,0x00,0x00,      
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      0x00,0x00,0x00,0x00,0x00,0x00,0x00,0x00,0x00,0x00,0x00,0x00,0x00,0x00,0x00,0x00 
};

///////////////////////////////////////////////////////////////
// I2C Control
///////////////////////////////////////////////////////////////

#define OLED_I2C_ADDR		0x78

static U8 CODE OLED_DisplayInitCmd[] = 
{ 
	0xAE,	//Display off
	0x00,	//lower column start line
	0x10,	//higher column
	0x40,	//display start line
	0x81,
	0x7F,	//contrast control register
	0xA1,	//column remap
	0xA6,	//normal control
	0xA8,	//Set multiplex ratio
	0x3F,	//64
	0xC8,	//Scan direction
	0xD3,
	0x00,	//display offset
	0xD5,
	0x80,	//display clock divide ratio/oscillator frequency
	0xDA,
	0x02,	//Com configuration
	0x8D,
	0x14,	//internal dc-dc
	0xAF,	//Display on
};

static U8 CODE OLED_DisplayPageCmd[] = {0xB4, 0x80, 0x00, 0x80, 0x10, 0x40};

typedef struct
{
	U8 speed_select;
	U8 settings;
	U16 length;
	U8 device_select;
	union
	{
		struct {
			U8 reg_addr;
		} std_write;
	} u;
	union
	{
		struct {
			U8 cmd[sizeof(OLED_DisplayPageCmd)];
			U8 buffer[OLED_PAGE_LENGTH];
		} page;
	} b;
} OLED_I2C_CTRL;

static OLED_I2C_CTRL XDATA gOLED_PageCtrl[OLED_TOTAL_PAGE];

PRIVATE void OLED_DelayInMs(U8 timeSlot)
{
	OST XDATA_PTR OledDelayTimerPtr = NULL; /*initialized MUST*/
	SYS_SetTimer(&OledDelayTimerPtr, timeSlot);
	while (!SYS_IsTimerExpired(&OledDelayTimerPtr));
	SYS_ReleaseTimer(&OledDelayTimerPtr);
}

/////////////////////////////////////////////////////////////////////////
//Add by Miles:
//each character is 8x16 with an index from 0 to 31 (U8 position)
//_______________________________________________________________________
//| 0 | 1 | 2 | 3 | 4 | 5 | 6 | 7 | 8 | 9 | 10 | 11 | 12 | 13 | 14 | 15 |
//____|___|___|___|___|___|___|___|___|___|____|____|____|____|____|____|
//|16 |17 |18 |19 |20 |21 |22 |23 |24 |25 | 26 | 27 | 28 | 29 | 30 | 31 |
//____|___|___|___|___|___|___|___|___|___|____|____|____|____|____|____|
//
/////////////////////////////////////////////////////////////////////////

PRIVATE void OLED_CharacterShow(U8 position, U8 charShow)
{
	charShow -= 0x20; //ASCII table offset 

	if (position < OLED_PAGE_LENGTH/OLED_WORD_LENGTH)
	{
		OSMEM_memcpy_xdata_code(&gOLED_PageCtrl[0].b.page.buffer[OLED_WORD_LENGTH*position], OLED_Libery[charShow], 8);
		OSMEM_memcpy_xdata_code(&gOLED_PageCtrl[1].b.page.buffer[OLED_WORD_LENGTH*position], OLED_Libery[charShow] + 8, 8);
	}
	else 
	{
		OSMEM_memcpy_xdata_code(&gOLED_PageCtrl[2].b.page.buffer[OLED_WORD_LENGTH*position - OLED_PAGE_LENGTH], OLED_Libery[charShow], 8);
		OSMEM_memcpy_xdata_code(&gOLED_PageCtrl[3].b.page.buffer[OLED_WORD_LENGTH*position - OLED_PAGE_LENGTH], OLED_Libery[charShow] + 8, 8);
	}	
}

PRIVATE void OLED_NumberToString(U8 XDATA_PTR OutPtr, U8 Number)
{
	U8 count = 3;
	while (count--)
	{
		OutPtr[count] = '0' + (Number % 10);
		Number /= 10;
	}
}

PRIVATE void OLED_NumberToHexString(U8 XDATA_PTR OutPtr, U8 Number)
{
	U8 hex;
	hex = Number / 16;
	OutPtr[0] = hex < 10 ? hex + '0' : hex + 'a' - 10;
	hex = Number % 16;
	OutPtr[1] = hex < 10 ? hex + '0' : hex + 'a' - 10;
}  

PRIVATE void OLED_ClearPage(U8 pageNum)
{
	OSMEM_memset_xdata(&gOLED_PageCtrl[pageNum].b.page.buffer[0], 0x00, OLED_PAGE_LENGTH);
} 

PRIVATE void OLED_DisplayPage(U8 pageNum)
{
	OSMEM_memcpy_xdata_code(&gOLED_PageCtrl[pageNum].b.page.cmd[0], OLED_DisplayPageCmd, sizeof(OLED_DisplayPageCmd));
	gOLED_PageCtrl[pageNum].b.page.cmd[0] = 0xB4 + pageNum;	
	I2C_StdAutoWriteChunk(OLED_I2C_ADDR, 0x80, sizeof(OLED_DisplayPageCmd)+OLED_PAGE_LENGTH, (U8 XDATA_PTR)&gOLED_PageCtrl[pageNum].b);
}

PRIVATE void OLED_StartupScreen(void)
{
	U8 pageNum;
	for (pageNum = 0; pageNum < OLED_TOTAL_PAGE; pageNum++)
	{
		OSMEM_memcpy_xdata_code(&gOLED_PageCtrl[pageNum].b.page.buffer[0], &OLED_StartupPicture[OLED_PAGE_LENGTH*pageNum], OLED_PAGE_LENGTH);
		OLED_DisplayPage(pageNum);
	}
}

PRIVATE void OLED_ClearScreen(void)
{
	U8 pageNum;
	for (pageNum = 0; pageNum < OLED_TOTAL_PAGE; pageNum++)
	{
		OLED_ClearPage(pageNum);
		OLED_DisplayPage(pageNum);
		//OLED_DelayInMs(OLED_DELAY_COUNT);
	}
} 

PUBLIC void OLED_DisplayOn(U8 showType)
{
	U8 XDATA_PTR ptr = SYS_MemoryGet(sizeof(OLED_DisplayInitCmd));
	if(ptr)
	{
		OSMEM_memcpy_xdata_code(ptr, OLED_DisplayInitCmd, sizeof(OLED_DisplayInitCmd));
		I2C_StdAutoWriteChunk(OLED_I2C_ADDR, 0x00, sizeof(OLED_DisplayInitCmd), ptr);
		OSMEM_Put(ptr);
		
		OLED_DelayInMs(OLED_DELAY_COUNT);
		if (showType == OLED_SHOW_NONE)
		{
			OLED_ClearScreen();
		}
		else
		{
			OLED_StartupScreen();
		}
	}
	else
	{
		ASSERT(FALSE);
	}
}

PUBLIC void OLED_DisplayOff(void)
{
	I2C_StdAutoWriteU8(OLED_I2C_ADDR, 0x00, 0xAE);
}

PUBLIC void OLED_ConnectionShow(U8 XDATA_PTR bdAddr_display, U8 XDATA_PTR name_display, U8 rssi_display)
{
	U8 LDATA output_str[3];
	U8 pageNum, position = 0;

	for (pageNum = 0; pageNum < OLED_TOTAL_PAGE; pageNum++)
	{
		OLED_ClearPage(pageNum);
	}

	// show device name
	if (name_display)
	{
		while (*name_display != 0x00)
		{
			OLED_CharacterShow(position++,*name_display++);
		}
	}

	// show rssi value
	if(rssi_display)
	{
		OLED_NumberToString((U8 XDATA_PTR)&output_str[0],rssi_display);
		
		if(position > OLED_PAGE_LENGTH/OLED_WORD_LENGTH)
		{
			OLED_CharacterShow(29,output_str[0]);
			OLED_CharacterShow(30,output_str[1]);
			OLED_CharacterShow(31,output_str[2]);
		}
		else 
		{
			OLED_CharacterShow(16,output_str[0]);	
			OLED_CharacterShow(17,output_str[1]);
			OLED_CharacterShow(18,output_str[2]);	
		} 
	}

	for (pageNum = 0; pageNum < OLED_TOTAL_PAGE; pageNum++)
	{
		OLED_DisplayPage(pageNum);
		//OLED_DelayInMs(OLED_DELAY_COUNT);
	}

	if (gOLED_ctl.OledShowBDAddr = bdAddr_display)
	{
		SYS_SetTimer(&gOLED_ctl.OledShowBDAddrTimerPtr, ONE_SEC*3);
	}
}

PUBLIC void OLED_DisconnectionShow(void)
{
	OLED_ClearScreen();
	SYS_ReleaseTimer(&gOLED_ctl.OledShowBDAddrTimerPtr);
}

PUBLIC void OLED_CheckTimer(void)
{
	U8 LDATA output_str[2];
	U8 i;

	if (SYS_IsTimerExpired(&gOLED_ctl.OledShowBDAddrTimerPtr))
	{
		OLED_ClearPage(OLED_PAGE2);
		OLED_ClearPage(OLED_PAGE3);

		for (i = 0; i < 6; i++)
		{
			OLED_NumberToHexString((U8 XDATA_PTR)&output_str[0],gOLED_ctl.OledShowBDAddr[i]);
			OLED_CharacterShow((U8)(30-2*i),output_str[0]);
			OLED_CharacterShow((U8)(31-2*i),output_str[1]);
		}

		OLED_DisplayPage(OLED_PAGE2);
		//OLED_DelayInMs(OLED_DELAY_COUNT);
		OLED_DisplayPage(OLED_PAGE3);
		//OLED_DelayInMs(OLED_DELAY_COUNT);
	}
}

#endif //OLED_ENABLE
